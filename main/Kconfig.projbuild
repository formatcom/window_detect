## main/Kconfig.projbuild
```kconfig
menu "OTA Configuration"

    config FIRMWARE_UPG_URL
        string "Firmware Upgrade URL"
        default "https://192.168.0.18:8070/firmware.bin"
        help
            URL of server which hosts the firmware image.

    config FIRMWARE_UPGRADE_URL_FROM_STDIN
        bool
        default y if FIRMWARE_UPG_URL = "FROM_STDIN"

    config SKIP_COMMON_NAME_CHECK
        bool "Skip server certificate CN fieldcheck"
        default n
        help
            This allows you to skip the validation of OTA server certificate CN field.

    config SKIP_VERSION_CHECK
        bool "Skip firmware version check"
        default n
        help
            This allows you to skip the firmware version check.

    config GPIO_DIAGNOSTIC
        int "Number of the GPIO input for diagnostic"
        range 0 39
        default 4
        help
            Used to demonstrate how a rollback works.
            The selected GPIO will be configured as an input with internal pull-up enabled.
            To trigger a rollback, this GPIO must be pulled low while the message
            `Diagnostics (5 sec)...` which will be on first boot.
            If GPIO is not pulled low then the operable of the app will be confirmed.

    config OTA_RECV_TIMEOUT
        int "OTA Receive Timeout"
        default 5000
        help
            Maximum time for reception

endmenu

menu "FIRMWARE Configuration"

    config N_SAMPLE
	int "Number of samples for filter sensor"
	default 15
	help
		n sample

    config RANGE_DETECT
	int "Range window detect"
	default 30
	help
            Range window detect

endmenu
```
